#include <Wire.h>
#include <Adafruit_GFX.h>
#include <Adafruit_SSD1306.h>
#include <pt.h>
#include <ESP8266WiFi.h>
#include <WiFiUdp.h>
#include <Servo.h>

#define SCREEN_WIDTH 128
#define SCREEN_HEIGHT 64

#define IMAGE_WIDTH 128
#define IMAGE_HEIGHT 64
Adafruit_SSD1306 display(SCREEN_WIDTH, SCREEN_HEIGHT, &Wire, -1);

static const uint8_t image_battery_full[1024] = {
 0x00, 0x00, 0x00, 0x00, 0x00, 0x00, 0x00, 0x00, 0x00, 0x00, 0x00, 0x00, 0x00, 0x00, 0x00, 0x00, 
	0x00, 0x00, 0x00, 0x00, 0x00, 0x00, 0x00, 0x00, 0x00, 0x00, 0x00, 0x00, 0x00, 0x00, 0x00, 0x00, 
	0x00, 0x00, 0x00, 0x00, 0x00, 0x00, 0x00, 0x00, 0x00, 0x00, 0x00, 0x00, 0x00, 0x00, 0x00, 0x00, 
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	0x00, 0x00, 0x00, 0x00, 0x00, 0x00, 0x00, 0x00, 0x00, 0x00, 0x00, 0x00, 0x00, 0x00, 0x00, 0x00
  };

static const uint8_t image_battery_4bars[1024] = {
 0x00, 0x00, 0x00, 0x00, 0x00, 0x00, 0x00, 0x00, 0x00, 0x00, 0x00, 0x00, 0x00, 0x00, 0x00, 0x00, 
	0x00, 0x00, 0x00, 0x00, 0x00, 0x00, 0x00, 0x00, 0x00, 0x00, 0x00, 0x00, 0x00, 0x00, 0x00, 0x00, 
	0x00, 0x00, 0x00, 0x00, 0x00, 0x00, 0x00, 0x00, 0x00, 0x00, 0x00, 0x00, 0x00, 0x00, 0x00, 0x00, 
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	0x00, 0x00, 0x00, 0x00, 0x00, 0x00, 0x00, 0x00, 0x00, 0x00, 0x00, 0x00, 0x00, 0x00, 0x00, 0x00
  };

static const uint8_t image_battery_3bars[1024] = {
 0x00, 0x00, 0x00, 0x00, 0x00, 0x00, 0x00, 0x00, 0x00, 0x00, 0x00, 0x00, 0x00, 0x00, 0x00, 0x00, 
	0x00, 0x00, 0x00, 0x00, 0x00, 0x00, 0x00, 0x00, 0x00, 0x00, 0x00, 0x00, 0x00, 0x00, 0x00, 0x00, 
	0x00, 0x00, 0x00, 0x00, 0x00, 0x00, 0x00, 0x00, 0x00, 0x00, 0x00, 0x00, 0x00, 0x00, 0x00, 0x00, 
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	0x00, 0x00, 0x00, 0x00, 0x00, 0x00, 0x00, 0x00, 0x00, 0x00, 0x00, 0x00, 0x00, 0x00, 0x00, 0x00
  };

static const uint8_t image_battery_2bars[1024] = {
0x00, 0x00, 0x00, 0x00, 0x00, 0x00, 0x00, 0x00, 0x00, 0x00, 0x00, 0x00, 0x00, 0x00, 0x00, 0x00, 
	0x00, 0x00, 0x00, 0x00, 0x00, 0x00, 0x00, 0x00, 0x00, 0x00, 0x00, 0x00, 0x00, 0x00, 0x00, 0x00, 
	0x00, 0x00, 0x00, 0x00, 0x00, 0x00, 0x00, 0x00, 0x00, 0x00, 0x00, 0x00, 0x00, 0x00, 0x00, 0x00, 
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	0x00, 0x00, 0x00, 0x00, 0x00, 0x00, 0x00, 0x00, 0x00, 0x00, 0x00, 0x00, 0x00, 0x00, 0x00, 0x00
  };

static const uint8_t image_battery_1bars[1024] = {
0x00, 0x00, 0x00, 0x00, 0x00, 0x00, 0x00, 0x00, 0x00, 0x00, 0x00, 0x00, 0x00, 0x00, 0x00, 0x00, 
	0x00, 0x00, 0x00, 0x00, 0x00, 0x00, 0x00, 0x00, 0x00, 0x00, 0x00, 0x00, 0x00, 0x00, 0x00, 0x00, 
	0x00, 0x00, 0x00, 0x00, 0x00, 0x00, 0x00, 0x00, 0x00, 0x00, 0x00, 0x00, 0x00, 0x00, 0x00, 0x00, 
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	0x00, 0x00, 0x00, 0x00, 0x00, 0x00, 0x00, 0x00, 0x00, 0x00, 0x00, 0x00, 0x00, 0x00, 0x00, 0x00
  };

static const uint8_t image_battery_empty[1024] = {
0x00, 0x00, 0x00, 0x00, 0x00, 0x00, 0x00, 0x00, 0x00, 0x00, 0x00, 0x00, 0x00, 0x00, 0x00, 0x00, 
	0x00, 0x00, 0x00, 0x00, 0x00, 0x00, 0x00, 0x00, 0x00, 0x00, 0x00, 0x00, 0x00, 0x00, 0x00, 0x00, 
	0x00, 0x00, 0x00, 0x00, 0x00, 0x00, 0x00, 0x00, 0x00, 0x00, 0x00, 0x00, 0x00, 0x00, 0x00, 0x00, 
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	0x00, 0x00, 0x00, 0x00, 0x00, 0x00, 0x00, 0x00, 0x00, 0x00, 0x00, 0x00, 0x00, 0x00, 0x00, 0x00
  };
static const uint8_t* OLEDCapacity[] = {image_battery_empty, image_battery_1bars, image_battery_2bars,image_battery_3bars, image_battery_4bars, image_battery_full};

static struct pt pt1;
const int buttonPin = 15;
bool buttonPressed = 0;
bool boosted = false;
bool charged = false;

// WiFi credentials
#define ssid "Galaxy S22A88A"         // Replace with your WiFi SSID
#define password "uzjw7402"           // Replace with your WiFi password

// Server settings
#define serverIP "192.168.4.121"      // Unity server's IP address
#define serverPort 11000               // Unity server's port

Servo servo;
WiFiUDP udp;

bool towerKilled = false;

void setup() {
  Serial.begin(115200);
 
  if(!display.begin(SSD1306_SWITCHCAPVCC, 0x3C)) {
    Serial.println(F("SSD1306 allocation failed"));
    for(;;);
  }
  delay(250); // Pause for 2 seconds
 
  // Clear the buffer.
  display.clearDisplay();
  int x = (SCREEN_WIDTH - IMAGE_WIDTH) / 2; // Should be 0 in this case
  int y = (SCREEN_HEIGHT - IMAGE_HEIGHT) / 2; // Should be 0 in this case
  display.clearDisplay();
  display.drawBitmap(x, y, image_battery_empty, IMAGE_WIDTH, IMAGE_HEIGHT, 1);
  display.display();
  PT_INIT(&pt1);

  servo.attach(0);
  servo.write(0);
  delay(10);

  Serial.print("Connecting to WiFi...");
  WiFi.mode(WIFI_STA);
  WiFi.begin(ssid, password);

  while (WiFi.status() != WL_CONNECTED) {
    delay(500);
    Serial.print(".");
  }

  Serial.println("\nConnected to WiFi");
  Serial.print("IP address: ");
  Serial.println(WiFi.localIP());
  udp.begin(serverPort);
}
 
void loop() {
  protothreadOLEDUpdate(&pt1);
  buttonPressed = digitalRead(buttonPin);
  
  if(towerKilled == false){
	  buttonPressed = digitalRead(buttonPin);
    if (receiveMessage() == "k"){
      servo.write(180);
      towerKilled = true;
      delay(500);
      servo.write(0);
      Serial.println("Tower destroyed!");
    }
    else if(buttonPressed == 1 && charged){
      delay(150);
      Serial.println("Pressed button!");
      buttonPressed = digitalRead(buttonPin);
      if(buttonPressed == 0){
        const char* message = "b";
        udp.beginPacket(serverIP, serverPort);
        udp.write(message);
        udp.endPacket();
        Serial.println("Message sent to boost tower!");
        buttonPressed = 0;
        boosted=true;
      }
    }
  }
  else{
    if(receiveMessage() == "r"){
      towerKilled = false;
      Serial.println("Message recieved to repair tower!");
    }
    delay(300);
  }
}

String receiveMessage() {
  int packetSize = udp.parsePacket();  // Check for an incoming UDP packet
  if (packetSize) {
    char incomingPacket[255];  // Buffer to hold incoming message
    int len = udp.read(incomingPacket, 255);
    if (len > 0) {
      incomingPacket[len] = '\0';  // Null-terminate the string
    }
    Serial.println(String(incomingPacket));
    return String(incomingPacket);  // Return as a String
  }
  return "";  // Return an empty String if no message was received
}

static int protothreadOLEDUpdate(struct pt *pt)
{
  static unsigned long lastTimeUpdated = 0;
  static unsigned long lastTimeUpdatedButton = 0;
  static unsigned int capacity = 1;
  static int x = (SCREEN_WIDTH - IMAGE_WIDTH) / 2; // Should be 0 in this case
  static int y = (SCREEN_HEIGHT - IMAGE_HEIGHT) / 2; // Should be 0 in this case
  PT_BEGIN(pt);
  while(1) {
    if (towerKilled == true){
      boosted=false;
      capacity = 0;
      lastTimeUpdated = millis();
      PT_WAIT_UNTIL(pt, millis() - lastTimeUpdated > 500);
      
    }
    else if(capacity<=5){
      boosted=false;
      lastTimeUpdated = millis();
      PT_WAIT_UNTIL(pt, millis() - lastTimeUpdated > 2000);
      display.clearDisplay();
      display.drawBitmap(x, y, OLEDCapacity[capacity], IMAGE_WIDTH, IMAGE_HEIGHT, 1);
      display.display();
      delay(300);
      capacity++;
    }
    else{
      charged = true;
      lastTimeUpdatedButton = millis();
      PT_WAIT_UNTIL(pt, millis() - lastTimeUpdatedButton > 350);
      if(boosted){
        Serial.println("Too qucik");
        capacity = 0;
        boosted = false;
        charged = false;
        
      }
    }
  }
  PT_END(pt);
}
